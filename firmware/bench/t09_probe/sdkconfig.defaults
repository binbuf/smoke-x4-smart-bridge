## firmware/bench/t09_probe/sdkconfig.defaults
```kconfig
CONFIG_IDF_TARGET="esp32s3"
CONFIG_ESPTOOLPY_FLASHSIZE_8MB=y
CONFIG_PARTITION_TABLE_CUSTOM=y
CONFIG_PARTITION_TABLE_CUSTOM_FILENAME="partitions.csv"
CONFIG_COMPILER_OPTIMIZATION_SIZE=y
CONFIG_BT_ENABLED=y
CONFIG_BT_NIMBLE_ENABLED=y
CONFIG_BT_NIMBLE_ROLE_PERIPHERAL=y
CONFIG_BT_NIMBLE_ROLE_BROADCASTER=y
CONFIG_BT_NIMBLE_ROLE_CENTRAL=n
CONFIG_BT_NIMBLE_ROLE_OBSERVER=n
CONFIG_BT_NIMBLE_EXT_ADV=n
CONFIG_ESP_MAIN_TASK_STACK_SIZE=4096
CONFIG_LOG_DEFAULT_LEVEL_INFO=y
```

## firmware/bench/t10_probe/sdkconfig.defaults
```kconfig
CONFIG_IDF_TARGET="esp32s3"
CONFIG_ESPTOOLPY_FLASHSIZE_8MB=y
CONFIG_PARTITION_TABLE_CUSTOM=y
CONFIG_PARTITION_TABLE_CUSTOM_FILENAME="partitions.csv"
CONFIG_COMPILER_OPTIMIZATION_SIZE=y
CONFIG_ESP_MAIN_TASK_STACK_SIZE=4096
CONFIG_LOG_DEFAULT_LEVEL_INFO=y
CONFIG_ESP_TASK_WDT_EN=n
```

## firmware/components/app_lora/Kconfig.projbuild
```kconfig
menu "Smoke Bridge — SX1262 wiring (ra01s)"
    # The vendored ra01s driver reads these CONFIG_* names; the defaults are
    # the Heltec WiFi LoRa 32 V3 wiring (design 01 §1.2), proven on the board.

    config MISO_GPIO
        int "SX1262 MISO GPIO"
        default 11

    config MOSI_GPIO
        int "SX1262 MOSI GPIO"
        default 10

    config SCLK_GPIO
        int "SX1262 SCLK GPIO"
        default 9

    config NSS_GPIO
        int "SX1262 NSS GPIO"
        default 8

    config RST_GPIO
        int "SX1262 RST GPIO"
        default 12

    config BUSY_GPIO
        int "SX1262 BUSY GPIO"
        default 13

    config TXEN_GPIO
        int "SX1262 TXEN GPIO (-1: unused)"
        default -1

    config RXEN_GPIO
        int "SX1262 RXEN GPIO (-1: unused)"
        default -1

    choice
        prompt "SPI peripheral"
        default SPI2_HOST
        config SPI2_HOST
            bool "SPI2_HOST"
        config SPI3_HOST
            bool "SPI3_HOST"
    endchoice
endmenu
```

## firmware/components/smoke_x/Kconfig.projbuild
```kconfig
menu "Smoke Bridge — smoke_x"
    config SMOKEBRIDGE_RESCAN_ENABLED
        bool "Re-scan for a base after 60 min of silence with no active cook"
        default n
        help
            Off by default deliberately (design 02 §2.7): silently
            re-pairing to a different base station would be worse than
            staying put. Never engages during an active cook either way.
endmenu
```

## firmware/main/Kconfig.projbuild
```kconfig
menu "Smoke Bridge"

    config SMOKEBRIDGE_BENCH_MODE
        bool "Bench diagnostic mode (V1.3/V1.4) instead of the bridge app"
        default n
        help
            Builds the one-sitting bench instrument from the M0 checklist
            instead of the bridge application. It exercises, continuously
            and with transcription-friendly log lines:

            - GPIO37-gated battery ADC on GPIO1, printing millivolts with
              the divider enabled and disabled plus the pack voltage under
              both disputed ratios (x4.9 vs x2.0) — V1.3
            - the PRG button (GPIO0) with debounce, the GPIO35 LED under
              LEDC PWM fades, the GPIO36 Vext gate, and the SSD1306 OLED
              on I2C @ 400 kHz while a Wi-Fi soft-AP is active — V1.4

            Build with:  idf.py -DSDKCONFIG_DEFAULTS="sdkconfig.defaults;
            sdkconfig.defaults.heltec-v3;sdkconfig.bench" build

endmenu
```
